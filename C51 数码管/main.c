#include <reg52.h>		   /*52系列单片机头文件*/
#include <smg.h>		   /*引用时钟函数*/
#include <delay.h>		   /*引用延迟函数*/
#include <add.h>		   /*引用数字增加函数*/

sbit K1=P3^4;					 /*申明K1键的控制端口*/
sbit K2=P3^5;					 /*申明K2键的控制端口*/


uchar t=0,n=0,s=0,f=0,m=0;						/*定义时分秒显示数字的起始状态*/


void main()						 				 /*主函数*/
	{
	   while(1)									/*进入循环*/
	   {
			if(K1==0)				  			/*监测到K1开关被按下时*/
			{
			   delay1(10);				   		/*延迟防抖动*/
			   if(K1==0)						/*确认K1键确实是被按下的时候，让时钟跳动*/
				 t=1;							/*给t赋值*/
				  	while(!K1);					/*继续执行循环*/
			}
			 if(K2==0)							/*当检测到K2键被按下时*/
			{
			    delay1(10);						/*延迟防止抖动*/
				if(K2==0)						/*确认K2键确实是被按下的时候，让时钟停止在目前状态*/
				t=0;						
				while(!K2);						/*没有检测到其他信号之前，继续保持时钟停止状态*/
			}
			if(t==1)
			{
			  	delay1(100);
			m=m+1;		   		/*秒钟累加*/
			if (m==60)		 	/*秒钟累加到60停止*/
				{
					m=0;
					f=f+1;	    /*分钟累加*/
					if (f==60)	/*分钟累加到60停止*/
					{
						f=0;
						s++;	 /*时钟累加*/
					}
				}	
			  display(m,f,s);
			}
			if(t==0)			   /*检测K2被按下*/
			display(m,f,s);
			


	}
	}